## CMakeLists.txt
```
# -------------------------------------------------------------------------------
# Zephyr Griffin Application
#
# Copyright (c) 2022 Trackunit
# SPDX-License-Identifier: Apache-2.0

cmake_minimum_required(VERSION 3.15.0)

project(PROJECT_NAME_HERE LANGUAGES C CXX ASM)


# get app version from git
set(APP_VERSION "0.0.0")
# find_package(Git QUIET)
# if(GIT_FOUND)
#     execute_process(
#         COMMAND ${GIT_EXECUTABLE} describe --always --dirty
#         WORKING_DIRECTORY ${CMAKE_CURRENT_SOURCE_DIR}
#         OUTPUT_VARIABLE APP_VERSION
#         OUTPUT_STRIP_TRAILING_WHITESPACE ERROR_STRIP_TRAILING_WHITESPACE
#     )
# endif()
message(STATUS "Application version: " ${APP_VERSION})
configure_file(app_version.h.in ${CMAKE_BINARY_DIR}/app_version.h)
set(CONFIG_KERNEL_BIN_NAME "tu700")
message(STATUS "CONFIG_KERNEL_BIN_NAME: " ${CONFIG_KERNEL_BIN_NAME})
string(APPEND CONFIG_KERNEL_BIN_NAME "_${APP_VERSION}")
message(STATUS "CONFIG_KERNEL_BIN_NAME: " ${CONFIG_KERNEL_BIN_NAME})

find_package(Zephyr REQUIRED HINTS $ENV{ZEPHYR_BASE})

target_include_directories(app PRIVATE
    ${CMAKE_CURRENT_SOURCE_DIR}/src
)

file(GLOB_RECURSE app_src
    ${CMAKE_CURRENT_SOURCE_DIR}/src/*.cpp
    ${CMAKE_CURRENT_SOURCE_DIR}/src/*.c
)

target_sources(app PRIVATE
    ${app_src}
)
```

## west.yml
```
# Equivalent to the above, but with manually maintained Zephyr modules.
manifest:
  remotes:
    - name: zephyrproject-rtos
      url-base: https://github.com/zephyrproject-rtos
  defaults:
    remote: zephyrproject-rtos
  projects:
    - name: zephyr
      path: vendor/zephyr
      revision: v3.1.0
      west-commands: scripts/west-commands.yml
  self:
    path: .
```

## prj.conf
```kconfig
# C lib
CONFIG_NEWLIB_LIBC=y
CONFIG_NEWLIB_LIBC_FLOAT_PRINTF=y
CONFIG_CBPRINTF_FP_SUPPORT=y
CONFIG_HEAP_MEM_POOL_SIZE=16384

# C++
CONFIG_CPLUSPLUS=y
CONFIG_STD_CPP17=y
CONFIG_LIB_CPLUSPLUS=y
CONFIG_EXCEPTIONS=n
CONFIG_RTTI=n
```

## src/main.cpp
```c
#include <cstdio>

#include <zephyr/zephyr.h>

void main(void)
{
    printf("Hello World");
}
```
